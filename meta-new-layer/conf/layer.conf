## meta-new-layer/conf/layer.conf
```bitbake
# We have a conf and classes directory, add to BBPATH
BBPATH .= ":${LAYERDIR}"

# We have recipes-* directories, add to BBFILES
BBFILES += "${LAYERDIR}/recipes-*/*/*.bb \
            ${LAYERDIR}/recipes-*/*.bbappend "

BBFILE_COLLECTIONS += "new-layer"
BBFILE_PATTERN_new-layer = "^${LAYERDIR}/"
BBFILE_PRIORITY_new-layer = "1"
LAYERVERSION_new-layer = "1"
```
